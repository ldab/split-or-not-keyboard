## boards/shields/son_basic60/Kconfig.defconfig
```kconfig
# Copyright (c) 2023 The ZMK Contributors
# SPDX-License-Identifier: MIT

if SHIELD_SON_BASIC60

config ZMK_KEYBOARD_NAME
    default "Son_Basic60"

endif
```

## boards/shields/son_basic60/Kconfig.shield
```kconfig
# Copyright (c) 2023 The ZMK Contributors
# SPDX-License-Identifier: MIT

config SHIELD_SON_BASIC60
   def_bool $(shields_list_contains,son_basic60)
```

## boards/shields/son_ergo56/Kconfig.defconfig
```kconfig
# Copyright (c) 2023 The ZMK Contributors
# SPDX-License-Identifier: MIT

if SHIELD_SON_ERGO56

config ZMK_KEYBOARD_NAME
    default "Son_Ergo56"

endif
```

## boards/shields/son_ergo56/Kconfig.shield
```kconfig
# Copyright (c) 2023 The ZMK Contributors
# SPDX-License-Identifier: MIT

config SHIELD_SON_ERGO56
   def_bool $(shields_list_contains,son_ergo56)
```
